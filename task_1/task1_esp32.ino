#include <Arduino.h>
#include "driver/i2s.h"
#include "driver/adc.h"
#include "esp_idf_version.h"

// Configuration
#define ADC_CHANNEL_USED  ADC1_CHANNEL_4   // GPIO32
#define TIMING_PIN        25               // I2S WS: hardware sample clock

#define SAMPLE_RATE       10000
#define SERIAL_BAUD       921600
#define BLOCK_SIZE        256
#define ADC_MAX_VALUE     4095

#define I2S_PORT          I2S_NUM_0
#define BUFFER_COUNT      2

// Explicit ping-pong buffers
uint16_t sampleBuffer[BUFFER_COUNT][BLOCK_SIZE];

struct CompletedBlock
{
    uint8_t bufferIndex;
    uint16_t sampleCount;
};

QueueHandle_t freeBufferQueue = nullptr;
QueueHandle_t completedBufferQueue = nullptr;

// Stop safely if hardware initialization fails
void stopOnError()
{
    pinMode(LED_BUILTIN, OUTPUT);

    while (true)
    {
        digitalWrite(LED_BUILTIN, HIGH);
        delay(150);
        digitalWrite(LED_BUILTIN, LOW);
        delay(150);
    }
}

// Configure hardware-timed ADC sampling through I2S0/DMA
void setupI2SADC()
{
    // Configure the ESP32 ADC1 input used by GPIO32.
    adc1_config_width(ADC_WIDTH_BIT_12);
    adc1_config_channel_atten(
        ADC_CHANNEL_USED,
        ADC_ATTEN_DB_11
    );

    i2s_config_t i2sConfig = {};

    i2sConfig.mode = static_cast<i2s_mode_t>(
        I2S_MODE_MASTER |
        I2S_MODE_RX |
        I2S_MODE_ADC_BUILT_IN
    );

    i2sConfig.sample_rate = SAMPLE_RATE;
    i2sConfig.bits_per_sample = I2S_BITS_PER_SAMPLE_16BIT;
    i2sConfig.channel_format = I2S_CHANNEL_FMT_ONLY_RIGHT;
    i2sConfig.communication_format = I2S_COMM_FORMAT_I2S_LSB;
    i2sConfig.intr_alloc_flags = ESP_INTR_FLAG_LEVEL1;

    // These are hardware DMA buffers. More than two buffers provide
    // additional protection while a completed block is transmitted.
    i2sConfig.dma_buf_count = 4;
    i2sConfig.dma_buf_len = BLOCK_SIZE;

    i2sConfig.use_apll = true;
    i2sConfig.tx_desc_auto_clear = false;
    i2sConfig.fixed_mclk = 0;

    if (
        i2s_driver_install(
            I2S_PORT,
            &i2sConfig,
            0,
            nullptr
        ) != ESP_OK
    )
    {
        stopOnError();
    }

    // Route the I2S word-select clock to GPIO25. Because this clock is
    // generated by the same I2S hardware that controls ADC/DMA sampling,
    // its rising-edge period can be checked with an oscilloscope.
    i2s_pin_config_t pinConfig = {};

#if ESP_IDF_VERSION_MAJOR >= 4
    pinConfig.mck_io_num = I2S_PIN_NO_CHANGE;
#endif

    pinConfig.bck_io_num = I2S_PIN_NO_CHANGE;
    pinConfig.ws_io_num = TIMING_PIN;
    pinConfig.data_out_num = I2S_PIN_NO_CHANGE;
    pinConfig.data_in_num = I2S_PIN_NO_CHANGE;

    if (
        i2s_set_pin(
            I2S_PORT,
            &pinConfig
        ) != ESP_OK
    )
    {
        stopOnError();
    }

    if (
        i2s_set_adc_mode(
            ADC_UNIT_1,
            ADC_CHANNEL_USED
        ) != ESP_OK
    )
    {
        stopOnError();
    }

    if (i2s_adc_enable(I2S_PORT) != ESP_OK)
    {
        stopOnError();
    }
}

// Acquisition task
void acquisitionTask(void *parameter)
{
    (void)parameter;

    while (true)
    {
        uint8_t bufferIndex = 0;

        // Wait until one of the two application buffers is free.
        xQueueReceive(
            freeBufferQueue,
            &bufferIndex,
            portMAX_DELAY
        );

        size_t receivedBytes = 0;

        esp_err_t result = i2s_read(
            I2S_PORT,
            sampleBuffer[bufferIndex],
            sizeof(sampleBuffer[bufferIndex]),
            &receivedBytes,
            portMAX_DELAY
        );

        if (result != ESP_OK || receivedBytes == 0)
        {
            xQueueSend(
                freeBufferQueue,
                &bufferIndex,
                portMAX_DELAY
            );

            continue;
        }

        uint16_t sampleCount = receivedBytes / sizeof(uint16_t);

        // In classic ESP32 I2S ADC mode, two adjacent 16-bit ADC words
        // are stored in reversed order by the RX FIFO. The ADC values
        // are also inverted. Restore the chronological order and convert
        // them back to the same 0..4095 convention as analogRead().
        uint16_t i = 0;

        for (; i + 1 < sampleCount; i += 2)
        {
            uint16_t firstWord =
                sampleBuffer[bufferIndex][i];

            uint16_t secondWord =
                sampleBuffer[bufferIndex][i + 1];

            sampleBuffer[bufferIndex][i] =
                ADC_MAX_VALUE - (secondWord & 0x0FFF);

            sampleBuffer[bufferIndex][i + 1] =
                ADC_MAX_VALUE - (firstWord & 0x0FFF);
        }

        // Handle a possible final unpaired sample.
        if (i < sampleCount)
        {
            sampleBuffer[bufferIndex][i] =
                ADC_MAX_VALUE -
                (sampleBuffer[bufferIndex][i] & 0x0FFF);
        }

        CompletedBlock completedBlock;
        completedBlock.bufferIndex = bufferIndex;
        completedBlock.sampleCount = sampleCount;

        // Hand the completed buffer to the transmission code.
        xQueueSend(
            completedBufferQueue,
            &completedBlock,
            portMAX_DELAY
        );
    }
}

// Setup
void setup()
{
    // Keep the same baud rate and binary uint16 format as the old program,
    // so the existing Python receiver remains compatible.
    Serial.setTxBufferSize(8192);
    Serial.begin(SERIAL_BAUD);

    delay(500);

    freeBufferQueue = xQueueCreate(
        BUFFER_COUNT,
        sizeof(uint8_t)
    );

    completedBufferQueue = xQueueCreate(
        BUFFER_COUNT,
        sizeof(CompletedBlock)
    );

    if (
        freeBufferQueue == nullptr ||
        completedBufferQueue == nullptr
    )
    {
        stopOnError();
    }

    // At startup, both ping-pong buffers are free.
    for (uint8_t i = 0; i < BUFFER_COUNT; i++)
    {
        xQueueSend(
            freeBufferQueue,
            &i,
            portMAX_DELAY
        );
    }

    setupI2SADC();

    BaseType_t taskCreated = xTaskCreatePinnedToCore(
        acquisitionTask,
        "ADC acquisition",
        4096,
        nullptr,
        3,
        nullptr,
        0
    );

    if (taskCreated != pdPASS)
    {
        stopOnError();
    }
}

// Transmission loop
void loop()
{
    CompletedBlock completedBlock;

    if (
        xQueueReceive(
            completedBufferQueue,
            &completedBlock,
            portMAX_DELAY
        ) == pdTRUE
    )
    {
        Serial.write(
            reinterpret_cast<uint8_t *>(
                sampleBuffer[completedBlock.bufferIndex]
            ),
            completedBlock.sampleCount * sizeof(uint16_t)
        );

        // The transmitted application buffer is now available again.
        xQueueSend(
            freeBufferQueue,
            &completedBlock.bufferIndex,
            portMAX_DELAY
        );
    }
}
